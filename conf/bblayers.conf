## conf/bblayers.conf
```bitbake
# POKY_BBLAYERS_CONF_VERSION is increased each time build/conf/bblayers.conf
# changes incompatibly
POKY_BBLAYERS_CONF_VERSION = "2"

BBPATH = "${TOPDIR}"
BBFILES ?= ""

BBLAYERS ?= " \
  /home/ats/projects/yocto/raspberry_pi/poky/meta \
  /home/ats/projects/yocto/raspberry_pi/poky/meta-poky \
  /home/ats/projects/yocto/raspberry_pi/poky/meta-yocto-bsp \
  /home/ats/projects/yocto/raspberry_pi/meta-openembedded/meta-oe \
  /home/ats/projects/yocto/raspberry_pi/meta-openembedded/meta-python \
  /home/ats/projects/yocto/raspberry_pi/meta-openembedded/meta-networking \
  /home/ats/projects/yocto/raspberry_pi/meta-openembedded/meta-multimedia \
  /home/ats/projects/yocto/raspberry_pi/meta-raspberrypi \
  "
```
